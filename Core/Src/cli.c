#include "FreeRTOS.h"
#include "FreeRTOS_CLI.h"
#include "string.h"

#include "usbd_cdc_if.h"
#include "usb_device.h"

#define MAX_INPUT_LENGTH    50
#define MAX_OUTPUT_LENGTH   100

static BaseType_t prvTaskStatsCommand( char *pcWriteBuffer,
                                          size_t xWriteBufferLen,
                                          const char *pcCommandString );

static BaseType_t prvHarmonicsStatsCommand( char *pcWriteBuffer,
                                          size_t xWriteBufferLen,
                                          const char *pcCommandString );

static BaseType_t prvHelpCommand( char *pcWriteBuffer,
                                          size_t xWriteBufferLen,
                                          const char *pcCommandString );                                          

static const int8_t * const pcWelcomeMessage =
  "FreeRTOS command server.rnType Help to view a list of registered commands.rn";

static const CLI_Command_Definition_t xTasksCommand =
{
	"tasks",
	"\r\ntasks:\r\n Lists all the installed tasks\r\n\r\n",
	prvTaskStatsCommand,
	0
};

static const CLI_Command_Definition_t xHarmonicsCommand =
{
	"harmonics",
	"\r\nharmonics:\r\n List of harmonics of a signal received by a microcontroller A/D converter\r\n\r\n",
	prvHarmonicsStatsCommand,
	0
};

static const CLI_Command_Definition_t xHelpCommand =
{
	"Help",
	"\r\nhelp:\r\n Returns the command manual\r\n\r\n",
	prvHelpCommand,
	0
};



void vCommandConsoleTask( void *pvParameters )
{

    //Peripheral_Descriptor_t xConsole;
    int8_t cRxedChar, cInputIndex = 0;
    BaseType_t xMoreDataToFollow;
    /* The input and output buffers are declared static to keep them off the stack. */
    //static int8_t pcOutputString[ MAX_OUTPUT_LENGTH ], pcInputString[ MAX_INPUT_LENGTH ];

    /* This code assumes the peripheral being used as the console has already
    been opened and configured, and is passed into the task as the task
    parameter.  Cast the task parameter to the correct type. */
    //xConsole = ( Peripheral_Descriptor_t ) pvParameters;

    /* Send a welcome message to the user knows they are connected. */
    //FreeRTOS_write( xConsole, pcWelcomeMessage, strlen( pcWelcomeMessage ) );
    /* init code for USB_DEVICE */
    MX_USB_DEVICE_Init();
    /* USER CODE BEGIN 5 */
    init_usb_rtos_obj();
    //char data[32];
	int qtd;
    /* Infinite loop */
	//Peripheral_Descriptor_t xConsole;
	cInputIndex = 0;

	FreeRTOS_CLIRegisterCommand( &xTasksCommand );
	FreeRTOS_CLIRegisterCommand( &xHarmonicsCommand );
    FreeRTOS_CLIRegisterCommand( &xHelpCommand );
	char data;

	//static const int8_t * const pcWelcomeMessage =
	//  "FreeRTOS command server.rnType Help to view a list of registered commands.rn";
	//BaseType_t xMoreDataToFollow;
	/* The input and output buffers are declared static to keep them off the stack. */
	static int8_t pcOutputString[ MAX_OUTPUT_LENGTH ], pcInputString[ MAX_INPUT_LENGTH ];

	/* This code assumes the peripheral being used as the console has already
	been opened and configured, and is passed into the task as the task
    parameter.  Cast the task parameter to the correct type. */
	//xConsole = ( Peripheral_Descriptor_t ) pvParameters;

	/* Send a welcome message to the user knows they are connected. */
    //qtd = receive_usb_data(data, 128, portMAX_DELAY);
    (void)queue_print_usb(pcWelcomeMessage, strlen( pcWelcomeMessage ), portMAX_DELAY);
	//(void)queue_print(pcWelcomeMessage, strlen( pcWelcomeMessage ));//write
	//  FreeRTOS_write( xConsole, pcWelcomeMessage, strlen( pcWelcomeMessage ) );

    for( ;; )
    {
        /* This implementation reads a single character at a time.  Wait in the
        Blocked state until a character is received. */
       // FreeRTOS_read( xConsole, &cRxedChar, sizeof( cRxedChar ) );
        qtd = receive_usb_data(data, 128, portMAX_DELAY);
        
        if( cRxedChar == '\n' ) // Talvez precise alterar aqui pra ser a variável data
        {
            /* A newline character was received, so the input command string is
            complete and can be processed.  Transmit a line separator, just to
            make the output easier to read. */
           // FreeRTOS_write( xConsole, "\r\n", strlen( "\r\n" );
            (void)queue_print_usb(data, qtd, portMAX_DELAY);
            /* The command interpreter is called repeatedly until it returns
            pdFALSE.  See the "Implementing a command" documentation for an
            exaplanation of why this is. */
            do
            {
                /* Send the command string to the command interpreter.  Any
                output generated by the command interpreter will be placed in the
                pcOutputString buffer. */
                xMoreDataToFollow = FreeRTOS_CLIProcessCommand
                              (
                                  pcInputString,   /* The command string.*/
                                  pcOutputString,  /* The output buffer. */
                                  MAX_OUTPUT_LENGTH/* The size of the output buffer. */
                              );

                /* Write the output generated by the command interpreter to the
                console. */
               // FreeRTOS_write( xConsole, pcOutputString, strlen( pcOutputString ) );

            } while( xMoreDataToFollow != pdFALSE );

            /* All the strings generated by the input command have been sent.
            Processing of the command is complete.  Clear the input string ready
            to receive the next command. */
            cInputIndex = 0;
            memset( pcInputString, 0x00, MAX_INPUT_LENGTH );
        }
        else
        {
            /* The if() clause performs the processing after a newline character
            is received.  This else clause performs the processing if any other
            character is received. */

            if( cRxedChar == '\r' )
            {
                /* Ignore carriage returns. */
            }
            else if( cRxedChar == '\b' )
            {
                /* Backspace was pressed.  Erase the last character in the input
                buffer - if there are any. */
                if( cInputIndex > 0 )
                {
                    cInputIndex--;
                    pcInputString[ cInputIndex ] = ' ';
                }
            }
            else
            {
                /* A character was entered.  It was not a new line, backspace
                or carriage return, so it is accepted as part of the input and
                placed into the input buffer.  When a n is entered the complete
                string will be passed to the command interpreter. */
                if( cInputIndex < MAX_INPUT_LENGTH )
                {
                    pcInputString[ cInputIndex ] = cRxedChar;
                    cInputIndex++;
                }
            }
        }
    }
}

/* This function implements the behaviour of a command, so must have the correct
prototype. */
static BaseType_t prvTaskStatsCommand( char *pcWriteBuffer,
                                          size_t xWriteBufferLen,
                                          const char *pcCommandString )
{
    /* For simplicity, this function assumes the output buffer is large enough
    to hold all the text generated by executing the vTaskList() API function,
    so the xWriteBufferLen parameter is not used. */
    ( void ) xWriteBufferLen;

    /* pcWriteBuffer is used directly as the vTaskList() parameter, so the table
    generated by executing vTaskList() is written directly into the output
    buffer. */
    vTaskList( pcWriteBuffer); //+ strlen( pcHeader ) );

    /* The entire table was written directly to the output buffer.  Execution
    of this command is complete, so return pdFALSE. */
    return pdFALSE;
}

/* This function implements the behaviour of a command, so must have the correct
prototype. */
static BaseType_t prvHarmonicsStatsCommand( char *pcWriteBuffer,
                                          size_t xWriteBufferLen,
                                          const char *pcCommandString )
{
    /* The entire table was written directly to the output buffer.  Execution
    of this command is complete, so return pdFALSE. */
    
    return pdFALSE;
}

static BaseType_t prvHelpCommand( char *pcWriteBuffer,
                                          size_t xWriteBufferLen,
                                          const char *pcCommandString )
{
	/* For simplicity, this function assumes the output buffer is large enough
	to hold all the text generated by executing the vTaskList() API function,
	so the xWriteBufferLen parameter is not used. */
	( void ) xWriteBufferLen;

	/* pcWriteBuffer is used directly as the vTaskList() parameter, so the table
	generated by executing vTaskList() is written directly into the output
	buffer. */
	vTaskList("Voce esta no comando HELP");


    /* The entire table was written directly to the output buffer.  Execution
    of this command is complete, so return pdFALSE. */
    return pdFALSE;
}
